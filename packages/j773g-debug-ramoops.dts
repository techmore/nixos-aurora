/dts-v1/;
/plugin/;

/ {
	fragment@0 {
		target-path = "/reserved-memory";

		__overlay__ {
			#address-cells = <2>;
			#size-cells = <2>;

			ramoops@103e0000000 {
				compatible = "ramoops";
				reg = <0x103 0xe0000000 0x0 0x200000>;
				record-size = <0x40000>;
				console-size = <0x100000>;
				pmsg-size = <0x40000>;
			};
		};
	};
};
